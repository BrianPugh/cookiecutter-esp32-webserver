## {{cookiecutter.project_name}}/src/Kconfig.projbuild
```kconfig
menu "{{cookiecutter.project_name}} Configuration"

    config PROJECT_MDNS_HOST_NAME
        string "mDNS Host Name"
        default "esp-webserver"
        help
            Specify the domain name used in the mDNS service.
            Note that webpage also take it as a part of URL where it will send GET/POST requests to.

    choice PROJECT_DEPLOY_MODE
        prompt "Website deploy mode"
        default PROJECT_WEB_DEPLOY_SEMIHOST
        help
            Select website deploy mode.
            You can deploy website to SD card or SPI flash, and ESP32 will retrieve them via SDIO/SPI interface.

        config PROJECT_WEB_DEPLOY_SF
            bool "Deploy website to SPI Nor Flash"
            help
                Deploy website to SPI Nor Flash.
                Choose this production mode if the size of website is small (less than 2MB).

        config PROJECT_WEB_DEPLOY_SD
            depends on IDF_TARGET_ESP32
            bool "Deploy website to SD card"
            help
                Deploy website to SD card.
                Choose this production mode if the size of website is too large (bigger than 2MB).
    endchoice

    config PROJECT_INDICATOR_LED_GPIO
        int "Blink GPIO number"
        range 0 34
        default 2
        help
            GPIO number (IOxx) to blink on and off to indicate status.

            Some GPIOs are used for other purposes (flash connections, etc.) and cannot be used to blink.

            GPIOs 35-39 are input-only so cannot be used as outputs.

endmenu
```
